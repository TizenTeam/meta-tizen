## meta-tizen-ivi/conf/distro/tizen-ivi.conf
```bitbake
require conf/distro/tizen.conf
DISTRO = "tizen-ivi"

# Use weston from Tizen since it contains Tizen specific patches
WESTONSTARTUP = ""
IMAGECONFIG = "config-tizen-ivi"
TLMCONFIG = "tlm-config-ivi-singleseat"

DISTRO_FEATURES += "tizen-ivi"

# Tizen IVI 3.0 does not use vconf-buxton yet.
PREFERRED_PROVIDER_vconf = "vconf"
PREFERRED_PROVIDER_vconf-native = "vconf-native"
```
